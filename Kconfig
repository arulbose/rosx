## Kconfig
```kconfig
#
# For a description of the syntax of this configuration file,
# see the file Documentation/kbuild/kconfig-language.txt in the
# Linux kernel source tree.
#
mainmenu "ROSX $ROSXVERSION Configuration"

config ROSXVERSION
	string
	option env="ROSXVERSION"

# Allow defaults in arch-specific code to override any given here
source "arch/Kconfig"
source "kernel/Kconfig"

menu "General setup"

config LOCALVERSION
	string "Local version - append to ROSX release"
	help
	  Append an extra string to the end of your U-Boot version.
	  This will show up in your boot log, for example.
	  The string you set here will be appended after the contents of
	  any files with a filename matching localversion* in your
	  object and source tree, in that order.  Your total string can
	  be a maximum of 64 characters.

config LOCALVERSION_AUTO
	bool "Automatically append version information to the version string"
	default y
	help
	  This will try to automatically determine if the current tree is a
	  release tree by looking for Git tags that belong to the current
	  top of tree revision.

	  A string of the format -gxxxxxxxx will be added to the localversion
	  if a Git-based tree is found.  The string generated by this will be
	  appended after any matching localversion* files, and after the value
	  set in CONFIG_LOCALVERSION.

	  (The actual string used here is the first eight characters produced
	  by running the command:

	    $ git rev-parse --verify HEAD

	  which is done within the script "scripts/setlocalversion".)

config CC_OPTIMIZE_FOR_SIZE
	bool "Optimize for size"
	default y
	help
	  Enabling this option will pass "-Os" instead of "-O2" to gcc
	  resulting in a smaller U-Boot image.

	  This option is enabled by default for U-Boot.
	  Select this to enable various options and commands which are suitable
	  for building u-boot for booting general purpose Linux distributions.

endmenu		# Boot images
```

## arch/arm/Kconfig
```kconfig
menu "ARM architecture"
	depends on ARM

config SYS_ARCH
	default "arm"

config HAS_VBAR
	bool

config HAS_THUMB2
	bool

# Used for compatibility with asm files copied from the kernel
config ARM_ASM_UNIFIED
	bool
	default y

# Used for compatibility with asm files copied from the kernel
config THUMB2_KERNEL
	bool

config CPU_V7M
	bool
	select HAS_THUMB2
	select THUMB2_KERNEL
	select SYS_CACHE_SHIFT_5

config SYS_CPU
	default "armv7m" if CPU_V7M

config SYS_ARM_ARCH
	int
	default 7 if CPU_V7M

config SYS_CACHE_SHIFT_5
	bool

config SYS_CACHE_SHIFT_6
	bool

config SYS_CACHE_SHIFT_7
	bool

config SYS_CACHELINE_SIZE
	int
	default 128 if SYS_CACHE_SHIFT_7
	default 64 if SYS_CACHE_SHIFT_6
	default 32 if SYS_CACHE_SHIFT_5

config SEMIHOSTING
	bool "support boot from semihosting"
	help
	  In emulated environments, semihosting is a way for
	  the hosted environment to call out to the emulator to
	  retrieve files from the host machine.

choice
	prompt "Target select"
	default TARGET_TIVA 

config TARGET_TIVA
	bool "Support TI TM4C1294NCPDT"

endchoice

source "arch/arm/mach-tiva/Kconfig"

source "arch/arm/cpu/armv7m/Kconfig"

source "board/tiva/Kconfig"

endmenu
```

## arch/arm/mach-tiva/Kconfig
```kconfig
if TARGET_TIVA

choice 
	prompt "TIVA TI board select"
	default BOARD_TM4C1294NCPDT

config BOARD_TM4C1294NCPDT
	bool "TIVA TI TM4C1294NCPDT EK"
	select CPU_ARMV7M

endchoice

config LDSCRIPT
	string
        default "arch/arm/mach-tiva/tm4c1294ncpdt/rosx.lds" if BOARD_TM4C1294NCPDT

endif
```

## kernel/Kconfig
```kconfig
# RosX kernel configuration

menu "Enable/Disable Kernel services -->"
#File tune parameters of the kernel to get the smallest footprint 
config SEMAPHORE
	bool
	prompt "Semaphore" 
	default y
	help
	Enable or disable kernel service

config MUTEX
	bool
	prompt "Mutex"
        default y
        help
        Enable or disable kernel service

config QUEUE
	bool
	prompt "Queue"
        default y
        help
        Enable or disable kernel service

config WAIT_QUEUE
	bool
	prompt "Wait/wake Queue"
        default y
        help
        Enable or disable kernel service

config EVENTS
	bool
	prompt "Events"
        depends on TIMERS
        default y
        help
        Enable or disable kernel service

config SYS_EVENT_STACK_SIZE
        int
        prompt "Timer thread default stack size"
        depends on TIMERS
        default 512
        help
        Maximum size of stack available for timer thread.

config TIMERS
	bool
	prompt "Kernel Timers"
	default y
	help
	Enable or disable kernel service

config TIMER_SYS_TIMER_STACK_SIZE
        int
        prompt "Timer thread default stack size"
        depends on TIMERS
        default 512
        help
        Maximum size of stack available for timer thread.

config SYS_BH
	bool
	prompt "Interrupt Tasklet/bottom-half"
        default y
        help
        Select Y if you need Tasklet/Bottom-half for interrupts.

config SYS_BH_STACK_SIZE
	int
	prompt "Interrupt Tasklet/bottom-half stack size"
        depends on SYS_BH
        default 512
        help
        Tasklet/Bottom-half stack size.

menu "RosX Kernel setup"

config MAX_TASK
	int
	prompt "maximum number of tasks"
	default 8
	help
	Maximum tasks supposed to be created. RosX Kernal does not limit it. It is limited by the resource available

config TASK_STR_LEN
	int
	prompt "Max length of task name"
	default 8
	help
	Maximum tasks supposed to be created. Must be 4 byte aligned.

config TIME_SLICE
        bool
	prompt "Task time slice"
	default n
	help
	If you want to support time-slice for task say Y.

config STACK_ALLOC_DYNAMIC
	bool
	prompt "Task dynamic allocation of stack"
	default n
	help
	If you want to allocated task stack size dynamically select as 'Y', you must provide the stack start and size.
	
config SYSTEM_STACK_SIZE
	int 
	prompt "System stack size"
	depends on STACK_ALLOC_DYNAMIC
	default 0
	help
	System stack size(4-byte aligned).Provide system stack size to manage dynamic allocation of stack while thread creation

config ISR_STACK_SIZE
	int
	prompt "ISRstack size"
	default 2048
	help
	ISR stack size	

config  HZ
	int
	prompt "Timer tick frequency"
	default 100
	help
	define timer tick frequency
endmenu

endmenu
```
